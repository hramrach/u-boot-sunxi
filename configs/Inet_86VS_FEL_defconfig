## configs/Inet_86VS_FEL_defconfig
```kconfig
CONFIG_SPL=y
CONFIG_FDTFILE="sun5i-inet-86vs.dtb"
CONFIG_SYS_EXTRA_OPTIONS="AXP209_POWER,UART0_PORT_F,SPL_FEL"
CONFIG_VIDEO=y
CONFIG_VIDEO_LCD_MODE="x:800,y:480,depth:18,pclk_khz:33000,le:45,ri:209,up:22,lo:22,hs:1,vs:1,sync:3,vmode:0"
CONFIG_VIDEO_LCD_POWER="AXP0-0"
CONFIG_VIDEO_LCD_BL_EN="AXP0-1"
CONFIG_VIDEO_LCD_BL_PWM="PB2"
CONFIG_USB_KEYBOARD=n
+S:CONFIG_ARM=y
+S:CONFIG_ARCH_SUNXI=y
+S:CONFIG_MACH_SUN5I=y
+S:CONFIG_TARGET_INET_86VS=y
```

## configs/Merrii_A80_Optimus_defconfig
```kconfig
CONFIG_FDTFILE="sun9i-a80-optimus.dtb"
CONFIG_VIDEO=n
CONFIG_USB_KEYBOARD=n
+S:CONFIG_ARM=y
+S:CONFIG_ARCH_SUNXI=y
+S:CONFIG_MACH_SUN9I=y
# unused but we must put something here for now
+S:CONFIG_DRAM_CLK=360
+S:CONFIG_DRAM_ZQ=123
```

## drivers/input/Kconfig
```kconfig
config SUN4I_KEYBOARD
	bool
	depends on ARCH_SUNXI
	prompt "Enable sunxi tablet keys"
	default y
	help
	  Support for the sunxi lradc used for tablet keys.
```
